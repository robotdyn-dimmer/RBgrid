## components/bench_kit/Kconfig
```kconfig
menu "RBgrid bench_kit (bench-only load control)"

config RBGRID_BENCH_KIT
    bool "Compile bench_kit (one-ESP32 bench: load control + YP9830 reference)"
    default n
    help
        Bench variant only (sdkconfig.bench). Production and public builds keep this off:
        the component then registers headers-free and zero-footprint.

endmenu
```

## components/rbpower/Kconfig
```kconfig
menu "RBPower Configuration"

    config RBPOWER_VERBOSE_DEBUG
        bool "Enable RBPower Verbose Debug Logging"
        default n
        help
            Enable extremely detailed verbose debug logging for RBPower modules:
            - Flash operations: detailed buffer state, sector transitions
            - Runtime config: slot allocation, metadata operations
            - Statistics: record-level tracking and cache operations

            WARNING: This produces MASSIVE log output and should ONLY be
            enabled when debugging specific Flash or statistics issues.
            This will significantly impact performance.

    menu "RBgrid interfaces (build keys)"
        config RBGRID_IF_WIFI
            bool "Wi-Fi (STA + setup access point) owned by RBgrid"
            default y
            help
                Off when a host (e.g. ESPHome) owns Wi-Fi. NVS, netif and the default event loop are then
                expected from the host (RBgrid tolerates them being initialised already).
        config RBGRID_IF_HTTP
            bool "HTTP server: REST API, WebSocket telemetry, web app hosting, OTA upload"
            depends on RBGRID_IF_WIFI
            default y
        config RBGRID_IF_MQTT
            bool "MQTT client: telemetry, command channel, Home Assistant discovery"
            default y
        config RBGRID_IF_SNTP
            bool "SNTP client owned by RBgrid"
            default y
            help
                Off when a host keeps the system clock (ESPHome `time: sntp`): RBgrid then starts no SNTP of its
                own, takes the system clock once it is real (not before the build day), and still runs its
                after-sync steps (clock-step flag, pending records, statistics timers).
        config RBGRID_IF_MDNS
            bool "mDNS announcement (rbgrid-xxxx.local, _rbgrid._tcp)"
            depends on RBGRID_IF_WIFI
            default y
    endmenu

    config RBGRID_POLL_TASK_PRIORITY
        int "rbAmp poll task priority (above idle)"
        range 1 10
        default 1
        help
            FreeRTOS priority of the rbAmp metering poll task (core 1), counted above idle. 1 in the standalone
            firmware, where core 1 is otherwise free. A host that runs its own loop on core 1 (ESPHome: loopTask,
            priority 1) sets it higher (5), so the poll cadence and the energy timestamps don't wait for the host.

    config RBGRID_PANIC_FORENSICS
        bool "Record the crash PC/backtrace in RTC memory for the next boot's event log"
        default y
        help
            Wraps esp_panic_handler (linker --wrap). Turn off when the host has its own panic wrapper
            (ESPHome's crash handler); the boot line then shows only the reset reason.

    config RBGRID_NVS_PARTITION
        string "NVS partition for RBgrid data"
        default "nvs"
        help
            NVS partition that holds RBgrid's own data: lifetime energy anchors, the open hour, net metering,
            migration flags, the ESP-NOW key / node settings, rbAmp anchors, OTA rollback notes.
            "nvs" (default, the product image): the default NVS partition, as on every installed hub.
            Another label (e.g. "rbnvs" in a build hosted by ESPHome) keeps this data in its own partition,
            so a host that erases the default NVS cannot take it. The partition must exist in the partition
            table. Wi-Fi credentials and the Wi-Fi driver's own data stay in the default "nvs".

endmenu # RBPower Configuration
```

## main/Kconfig.projbuild
```kconfig
menu "RBgrid"

config RBGRID_DEBUG_BRIDGE
    bool "Enable rbbench debug bridge console (HW test/debug)"
    default n
    help
        Compile the rbbench debug-bridge console into RBgrid (the test-rig
        harness). Exposes a UART0 BRIDGE_SHELL line protocol with i2c/load/meter
        verbs plus RBgrid introspection verbs, for hardware-in-the-loop testing
        (load sweeps, reference meter, flash diagnostics). Off in production.
        When enabled, RBgrid also starts the rbAmp bridge (to provide the shared
        sensor I2C bus handle) and lowers the log level so the console stays clean.

config RBGRID_BENCH_FULL
    bool "Unified bench build (rbbench console + wifi/telemetry together)"
    default n
    help
        Compile the rbbench debug-bridge console (load/meter/i2cscan
        verbs) ALONGSIDE the full wifi/telemetry/MQTT stack in one image. PSRAM
        removed the RAM/console split that used to force them apart, so the stand
        can drive controlled loads AND validate the live telemetry pipeline from a
        single build. Unlike RBGRID_DEBUG_BRIDGE this keeps wifi ON. Off in
        production. Set ESP_CONSOLE_NONE so rbbench owns the UART0 driver (app logs
        still emit via the ROM printf path).

endmenu
```
